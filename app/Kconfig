## app/Kconfig
```kconfig
source "Kconfig.zephyr"

menuconfig LED_SUBSYSTEM
    bool "LED Subsystem"
    default y

if LED_SUBSYSTEM
    choice LED_BLINK_SLEEP
        prompt "LED blink sleep time"
        default LED_BLINK_SLEEP_250MS

    config LED_BLINK_SLEEP_250MS
        bool "250 ms"

    config LED_BLINK_SLEEP_500MS
        bool "500 ms"

    config LED_BLINK_SLEEP_1S
        bool "1 s"

    config LED_BLINK_SLEEP_2S
        bool "2 s"
    endchoice

    config LED_BLINK_SLEEP_MS
        int
        default 250 if LED_BLINK_SLEEP_250MS
        default 500 if LED_BLINK_SLEEP_500MS
        default 1000 if LED_BLINK_SLEEP_1S
        default 2000 if LED_BLINK_SLEEP_2S

    menuconfig LED_ADVANCED
        bool "Advanced LED settings"

    if LED_ADVANCED
        config LED_BRIGHTNESS
            int "LED brightness"
            range 0 100
            default 100

        config LED_FADE
            int "LED fade time (ms)"
            range 0 5000
            default 500

        menu "Expert settings"
            visible if LED_ADVANCED

            config LED_DEBUG
                bool "Enable LED debugging"
                default n
            config BLINK_PATTERN
                bool "Custom blink pattern"
                default n
        endmenu
    endif
endif
```
